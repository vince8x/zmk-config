## boards/shields/cheapino/Kconfig.defconfig
```kconfig
# Copyright (c) 2022 The ZMK Contributors
# SPDX-License-Identifier: MIT

if SHIELD_CHEAPINO

config ZMK_KEYBOARD_NAME
	default "cheapino"

endif # SHIELD_CHEAPINO
```

## boards/shields/cheapino/Kconfig.shield
```kconfig
# Copyright (c) 2022 The ZMK Contributors
# SPDX-License-Identifier: MIT

config SHIELD_CHEAPINO
    def_bool $(shields_list_contains,cheapino)
```

## boards/shields/cresk_100/Kconfig.defconfig
```kconfig
# Copyright (c) 2022 The ZMK Contributors
# SPDX-License-Identifier: MIT

if SHIELD_CRESK_100

config ZMK_KEYBOARD_NAME
	default "cresk_100"

if ZMK_DISPLAY

config I2C
    default y

config SSD1306
    default y

endif # ZMK_DISPLAY

if LVGL

config LV_Z_SIZE
	default 100

config LV_DPI_DEF
	default 148

config LV_Z_BITS_PER_PIXEL
	default 1

choice LV_COLOR_DEPTH
	default LV_COLOR_DEPTH_1
endchoice

endif # LVGL

endif # SHIELD_CRESK_100
```

## config/west.yml
```yaml
manifest:
  remotes:
    - name: zmkfirmware
      url-base: https://github.com/zmkfirmware
    - name: urob
      url-base: https://github.com/urob
    - name: glebsexy
      url-base: https://github.com/glebsexy
    - name: vince8x
      url-base: https://github.com/vince8x
  projects:
    - name: zmk
      remote: vince8x
      revision: main
      import: app/west.yml
  self:
    path: config
```
